## drivers/net/wireless/atmel/Kconfig
```kconfig
menuconfig AT_WI
    bool "Atmel SmartConnect wireless cards Driver"
    depends on WLAN && CFG80211
#    select WIRELESS_EXT
#    select WEXT_PRIV
    ---help---
      This module adds support for wireless adapters based on
      Atmel chipsets.

if AT_WI

source "drivers/net/wireless/atmel/wilc1000/Kconfig"

endif
```
